#include "doctest.h"
#include "crossing_pattern.h"

#include <cstring>
#include <initializer_list>

// ---------------------------------------------------------------------------
// Proof-of-equivalence test for the generated crossing animation.
//
// The two frames used to ship as hand-stored 1 KB PROGMEM bitmaps. They were
// deleted in favour of crossing_pattern::frameRects(); the original bytes are
// pinned below as goldens. Rasterizing the emitted rectangles must reproduce
// them exactly — every one of the 128x64 pixels, both frames — so the change
// is provably invisible on the device.
//
// Bit order matches Adafruit_GFX drawBitmap(): row-major, 16 bytes per row,
// MSB = leftmost pixel of each byte.
// ---------------------------------------------------------------------------

// Golden: the original hand-stored image_data_calculating1[] bitmap (1024 B).
static const unsigned char kGoldenA[1024] = {
    0x00, 0x00, 0x00, 0x00, 0x00, 0x00, 0x00, 0x00, 0x00, 0x00, 0x00, 0x00, 0x00, 0x00, 0x00,
    0x00, 0x00, 0x00, 0x00, 0x00, 0x00, 0x00, 0x00, 0x00, 0x00, 0x00, 0x00, 0x00, 0x00, 0x00,
    0x00, 0x00, 0x00, 0x00, 0x00, 0x00, 0x00, 0x00, 0x00, 0x00, 0x00, 0x00, 0x00, 0x00, 0x00,
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    0x00, 0x00, 0xff, 0xff
};

// Golden: the original hand-stored image_data_calculating2[] bitmap (1024 B).
static const unsigned char kGoldenB[1024] = {
    0x00, 0x00, 0x00, 0x00, 0x00, 0x00, 0x00, 0x00, 0x00, 0x00, 0x00, 0x00, 0x00, 0x00, 0x00,
    0x00, 0x00, 0x00, 0x00, 0x00, 0x00, 0x00, 0x00, 0x00, 0x00, 0x00, 0x00, 0x00, 0x00, 0x00,
    0x00, 0x00, 0x00, 0x00, 0x00, 0x00, 0x00, 0x00, 0x00, 0x00, 0x00, 0x00, 0x00, 0x00, 0x00,
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    0xff, 0xff, 0x00, 0x00
};

namespace {

// Rasterize one frame's rectangles into a 1024-byte 1bpp buffer.
void rasterize(bool flip, unsigned char* buf) {
    std::memset(buf, 0, 1024);
    crossing_pattern::Rect r[crossing_pattern::kMaxRects];
    const int n = crossing_pattern::frameRects(flip, r, crossing_pattern::kMaxRects);
    for (int i = 0; i < n; i++) {
        for (int y = r[i].y; y < r[i].y + r[i].h; y++) {
            for (int x = r[i].x; x < r[i].x + r[i].w; x++) {
                buf[y * 16 + x / 8] |= (unsigned char)(0x80 >> (x % 8));
            }
        }
    }
}

}  // namespace

TEST_CASE("frameRects - flip=true reproduces the original frame 1 bitmap") {
    unsigned char buf[1024];
    rasterize(true, buf);
    CHECK(std::memcmp(buf, kGoldenA, 1024) == 0);
}

TEST_CASE("frameRects - flip=false reproduces the original frame 2 bitmap") {
    unsigned char buf[1024];
    rasterize(false, buf);
    CHECK(std::memcmp(buf, kGoldenB, 1024) == 0);
}

TEST_CASE("frameRects - emits 8 cells per frame, all 16x16, on the odd row bands") {
    crossing_pattern::Rect r[crossing_pattern::kMaxRects];
    for (bool flip : {false, true}) {
        const int n = crossing_pattern::frameRects(flip, r, crossing_pattern::kMaxRects);
        CHECK(n == 8);
        for (int i = 0; i < n; i++) {
            CHECK(r[i].w == 16);
            CHECK(r[i].h == 16);
            // odd 16px row bands only: y = 16 or 48
            CHECK(((r[i].y / 16) % 2) == 1);
            CHECK(r[i].x >= 0);
            CHECK(r[i].x + r[i].w <= crossing_pattern::kWidth);
            CHECK(r[i].y + r[i].h <= crossing_pattern::kHeight);
        }
    }
}

TEST_CASE("frameRects - the two frames are column-disjoint (they alternate)") {
    crossing_pattern::Rect a[8], b[8];
    crossing_pattern::frameRects(true, a, 8);
    crossing_pattern::frameRects(false, b, 8);
    for (int i = 0; i < 8; i++) {
        for (int j = 0; j < 8; j++) {
            const bool samePosition = (a[i].x == b[j].x) && (a[i].y == b[j].y);
            CHECK_FALSE(samePosition);
        }
    }
}

TEST_CASE("frameRects - respects a short output buffer and rejects bad input") {
    crossing_pattern::Rect r[3];
    CHECK(crossing_pattern::frameRects(true, r, 3) == 3);
    CHECK(crossing_pattern::frameRects(true, nullptr, 8) == 0);
    CHECK(crossing_pattern::frameRects(true, r, 0) == 0);
}
